#include "Crc16.h"

/*==============================================================================
 *  CRC-16/KERMIT（★ 逐字搬自 SD_SPI.c 里那个【已验证】的实现 ✓
 *                 —— 不重新发明 ✗ 只搬家 ✓）
 *
 *  反射算法：每次右移一位 ✓；最低位为 1 就异或反射多项式 0x8408 ✓
 *
 *  ★ 为什么不用 STM32 的硬件 CRC 外设 ✗：
 *    · F103 的硬件 CRC 是 CRC-32（以太网多项式 ✓）—— 不是 16 位 ✗
 *    · 而且它的位序/初值固定，和我们这个契约不符 ✗
 *    → ★ 软件实现够快：72MHz 下算 38 字节约几微秒 ✓（远小于 100ms 节拍 ✓）
 *
 *  ★ 自检提示（PC 侧/调试用）：
 *    输入 "123456789" 应得 0x2189 ✓✓
 * ============================================================================*/
uint16_t Crc16_Kermit(const uint8_t *d, uint32_t len)
{
	uint16_t crc = 0u;                           /* ★ 初值 0 ✓（契约 ✓）*/
	uint32_t i;
	uint8_t  b;

	for (i = 0u; i < len; i++)
	{
		crc ^= (uint16_t)d[i];
		for (b = 0u; b < 8u; b++)
		{
			crc = (crc & 0x0001u) ? (uint16_t)((crc >> 1) ^ 0x8408u)
			                      : (uint16_t)(crc >> 1);
		}
	}
	return crc;                                  /* ★ 无输出异或 ✓ */
}

/*==============================================================================
 *  ★★★★ CRC-16/XMODEM —— SD 数据块要求的那个变体（2026-10-14 加 ✓）
 *
 *   ★ 为什么必须和 Crc16_Kermit 分开 ✗：
 *     · KERMIT：多项式 0x8408（0x1021 的反射 ✗）低位先算 ✓
 *     · XMODEM：多项式 0x1021 ✗ 【不反射 ✗ 高位先算】✓
 *     ★★★ 两者结果完全不同 ✗ 不能混用 ✓
 *
 *   ★★ 契约（★ 判据 ✗ 上电打一行自己验 ✓）✗
 *     · Crc16_Kermit ("123456789") → 【0x2189】✓
 *     · Crc16_Xmodem ("123456789") → 【0x31C3】✓
 *
 *   ★★★ 用在哪 ✗：★ SD 卡【数据块】的 CRC（CMD24 / CMD25 ✓）
 *     注意：★ 不是【命令】的 CRC ✗ 那个是 CRC-7 ✓（★ 别混 ✓）
 *============================================================================*/
uint16_t Crc16_Xmodem(const uint8_t *d, uint32_t len)
{
	uint16_t crc = 0x0000u;                              /* ★ 初值 0 ✓ */
	uint32_t i;
	uint8_t  b;

	for (i = 0u; i < len; i++)
	{
		crc ^= (uint16_t)((uint16_t)d[i] << 8);          /* ★ 高位先 ✗ 不反射 ✓ */
		for (b = 0u; b < 8u; b++)
		{
			if ((crc & 0x8000u) != 0u)
			{
				crc = (uint16_t)((crc << 1) ^ 0x1021u);  /* ★ 多项式 ✓ */
			}
			else
			{
				crc = (uint16_t)(crc << 1);
			}
		}
	}
	return crc;
}
